## config/west.yml
```yaml
manifest:
  defaults:
    revision: v0.3
  remotes:
    - name: homerowkb
      url-base: https://github.com/homerowkb
  projects:
    - name: zmk-homerow
      path: zmk
      repo-path: zmk
      remote: homerowkb
      revision: enrico/add-multiprofile-support
      import: app/west.yml
    - name: zmk-keyboard-radiata
      remote: homerowkb
      revision: main
  self:
    path: config
```
